## devices/hi3516cv6xx_waybeam_h5svx-imx335/general/package/waybeam/Config.in
```kconfig
config BR2_PACKAGE_WAYBEAM
	bool "waybeam"
	depends on BR2_TOOLCHAIN_HAS_THREADS
	depends on BR2_PACKAGE_SIGMASTAR_OSDRV_INFINITY6E || \
		BR2_PACKAGE_HISILICON_OSDRV_HI3516CV6XX
	depends on !BR2_PACKAGE_MAJESTIC
	help
	  Standalone H.265 video encoder and streamer for SigmaStar
	  Infinity6E (SSC338Q/SSC30KQ) and HiSilicon Hi3516CV6xx.
	  Provides an HTTP configuration API compatible with the keys
	  wfb-ng and adaptive-link drive.

	  It is an alternative to the Majestic streamer and cannot be
	  built alongside it: both drive the same sensor and encoder
	  hardware.

	  On Hi3516CV6xx it drives the openhisilicon sensor plugin named
	  by CV610_SENSOR in /etc/waybeam-cv610.conf and uses the MPP
	  modules load_hisilicon brings up at boot.

	  https://github.com/OpenIPC/waybeam
```
